/*@!Encoding:1252*/
variables 
{
  message 0x762 msg = {dlc = 8, byte(0) = 0x05, byte(1) = 0x22, byte(2) = 0xFE, byte(3) = 0x01};
}

on message 0x726
{  
  if(this.byte(4)== 0x01) //Checks for Enable Byte.
  {
    
      switch(this.byte(3))
      {
        case 0x01: 
                   if(@Demo::Failure == 0)
                   {
                     $EngineState::EngineSpeed = this.byte(6) * 13.7;
                     msg.byte(4) = this.byte(4);
                     msg.byte(5) = this.byte(5);
                     msg.byte(6) = this.byte(6);
                     output(msg);

                   }
                   break;
                  
        case 0x04: if(@Demo::Failure == 0)
                   {
                     $EngineState::OnOff = this.byte(5);
                     msg.byte(3) = this.byte(3);
                     msg.byte(4) = this.byte(4);
                     msg.byte(5) = this.byte(5);
                     msg.byte(6) = this.byte(6);
                     output(msg);
                   }
                   break;
      }
  }
  else if(this.byte(4)== 0x00)
  {
    $EngineState::EngineSpeed = 0x00;
    $EngineState::OnOff = 0x00;
  }
    
}

on sysvar sysvar::Demo::Failure
{
  if(@Demo::Failure == 1)
  {
      msg.byte(4) = 0xFF;
      msg.byte(5) = 0xFF;
      msg.byte(6) = 0xFF;
      output(msg);
  }
  
}

on sysvar sysvar::Engine::EngineStateSwitch
{
 $EngineState::OnOff = @this;
  if(@this)
    $EngineState::EngineSpeed = @sysvar::Engine::EngineSpeedEntry;
  else
    $EngineState::EngineSpeed = 0;
}

on sysvar sysvar::Engine::EngineSpeedEntry
{
  if(@sysvar::Engine::EngineStateSwitch) 
  {
    $EngineState::EngineSpeed = @this;
  }
}

