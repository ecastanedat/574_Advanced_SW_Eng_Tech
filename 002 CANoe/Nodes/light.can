/*@!Encoding:1252*/
variables 
{
  message 0x762 msg = {dlc = 8, byte(0) = 0x05, byte(1) = 0x22, byte(2) = 0xFE, byte(3) = 0x01};
  
  msTimer tFlashLightFrequency;
  const int gFlashLightFrequency = 500;
  int gHazardLightsStatus = 0;

  int gDebugCounterTX = 0;
  int gDebugCounterTXRQ = 0;
  int gDebugCounterRX = 0;
  int failure = 0;
}

on start
{
   setWriteDbgLevel(0); // set DbgLevel = 1 to get more information in Write-Window
}

on message LightState 
{
 
  if (this.dir == TX)
  {
    gDebugCounterTX++;
    if(gDebugCounterTX == 10)
    {
      writeDbgLevel(1,"LightState TX received by node %NODE_NAME%");
      gDebugCounterTX = 0;
    }     
  }
  if(this.dir == TXREQUEST)
  {
    gDebugCounterTXRQ++;
    if(gDebugCounterTXRQ == 10)
    {
      writeDbgLevel(1,"LightState TXREQUEST received by node %NODE_NAME%");
      gDebugCounterTXRQ = 0;
    } 
  }
  if (this.dir == RX)
  {
    gDebugCounterRX++;
    if(gDebugCounterRX == 10)
    {
      writeDbgLevel(1,"Error: LightState RX received by node %NODE_NAME%");
      gDebugCounterRX = 0;
    }
  }
}

on message 0x726
{
  
  if(this.byte(4)== 0x01)
  {
      switch(this.byte(3))
      {
        case 0x02: if(@Demo::Failure == 0)
                   {
                     $HeadLight = 1;
                     msg.byte(3) = this.byte(3);
                     msg.byte(4) = this.byte(4);
                     msg.byte(5) = this.byte(5);
                     msg.byte(6) = this.byte(6);
                     output(msg);
                           
                   }
                   break;
                  
         case 0x03:  if(@Demo::Failure == 0)
                     {
                        @Lights::HazardLightsSwitch = 1;
                        msg.byte(3) = this.byte(3);
                        msg.byte(4) = this.byte(4);
                        msg.byte(5) = this.byte(5);
                        msg.byte(6) = this.byte(6);
                        output(msg);
                     }
                     break;
      }
  }
  else if(this.byte(4)== 0x00)
  {
    setSignal(HeadLight, 0);
  }
    
}

on timer tFlashLightFrequency
{
  gHazardLightsStatus = (gHazardLightsStatus == 1 ? 0 : 1);
  $LightState::FlashLight = gHazardLightsStatus;
  setTimer(this, gFlashLightFrequency);
}

on key '0'
{
  setwriteDbgLevel(0);
}

on key '1'
{
  setwriteDbgLevel(1);
}

on sysvar sysvar::Lights::HazardLightsSwitch
{
  if (@this)
  {
    gHazardLightsStatus = 1;
    setTimer(tFlashLightFrequency, gFlashLightFrequency);
  }
  else
  {
    cancelTimer(tFlashLightFrequency);
    gHazardLightsStatus = 0;
  }

  $LightState::FlashLight = gHazardLightsStatus;
}

